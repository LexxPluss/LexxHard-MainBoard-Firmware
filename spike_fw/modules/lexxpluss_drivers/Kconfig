## spike_fw/modules/lexxpluss_drivers/Kconfig
```kconfig
# SPDX-License-Identifier: BSD-2-Clause
rsource "drivers/sensor/maxbotix/Kconfig"
rsource "drivers/sensor/adis16470/Kconfig"
```

## spike_minimal/boards/lexxpluss/lexxpluss_mb02/board.yml
```yaml
board:
  name: lexxpluss_mb02
  full_name: LexxPluss Main Control Unit board V2
  vendor: lexxpluss
  socs:
    - name: stm32f769xx
```
