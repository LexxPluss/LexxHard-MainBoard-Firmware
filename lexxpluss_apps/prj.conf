## west.yml
```
# Copyright (c) 2022, LexxPluss Inc.
# All rights reserved.
#
# Redistribution and use in source and binary forms, with or without
# modification, are permitted provided that the following conditions are met:
#
# 1. Redistributions of source code must retain the above copyright notice,
#    this list of conditions and the following disclaimer.
# 2. Redistributions in binary form must reproduce the above copyright notice,
#    this list of conditions and the following disclaimer in the documentation
#    and/or other materials provided with the distribution.
#
# THIS SOFTWARE IS PROVIDED BY THE COPYRIGHT HOLDERS AND CONTRIBUTORS "AS IS" AND
# ANY EXPRESS OR IMPLIED WARRANTIES, INCLUDING, BUT NOT LIMITED TO, THE IMPLIED
# WARRANTIES OF MERCHANTABILITY AND FITNESS FOR A PARTICULAR PURPOSE ARE
# DISCLAIMED. IN NO EVENT SHALL THE COPYRIGHT OWNER OR CONTRIBUTORS BE LIABLE FOR
# ANY DIRECT, INDIRECT, INCIDENTAL, SPECIAL, EXEMPLARY, OR CONSEQUENTIAL DAMAGES
# (INCLUDING, BUT NOT LIMITED TO, PROCUREMENT OF SUBSTITUTE GOODS OR SERVICES;
# LOSS OF USE, DATA, OR PROFITS; OR BUSINESS INTERRUPTION) HOWEVER CAUSED AND
# ON ANY THEORY OF LIABILITY, WHETHER IN CONTRACT, STRICT LIABILITY, OR TORT
# (INCLUDING NEGLIGENCE OR OTHERWISE) ARISING IN ANY WAY OUT OF THE USE OF THIS
# SOFTWARE, EVEN IF ADVISED OF THE POSSIBILITY OF SUCH DAMAGE.

manifest:
  remotes:
    - name: zephyrproject-rtos
      url-base: https://github.com/zephyrproject-rtos
    - name: lexxpluss
      url-base: https://github.com/LexxPluss
    - name: micro-ROS
      url-base: https://github.com/micro-ROS
  projects:
    - name: zephyr
      remote: zephyrproject-rtos
      revision: v4.1.0
      import:
        name-allowlist:
          - cmsis
          - fatfs
          - cmsis_6
          - hal_stm32
          - mcuboot
          - picolibc
          - zcbor
          - mbedtls
          - tinycrypt
    - name: ros_msgs
      remote: lexxpluss
      revision: main
      path: ros_msgs
    - name: micro_ros_zephyr_module
      remote: micro-ROS
      revision: jazzy
      path: micro_ros_zephyr_module
  self:
    path: lexxpluss_apps
```

## prj.conf
```kconfig
# Copyright (c) 2022, LexxPluss Inc.
# All rights reserved.
#
# Redistribution and use in source and binary forms, with or without
# modification, are permitted provided that the following conditions are met:
#
# 1. Redistributions of source code must retain the above copyright notice,
#    this list of conditions and the following disclaimer.
# 2. Redistributions in binary form must reproduce the above copyright notice,
#    this list of conditions and the following disclaimer in the documentation
#    and/or other materials provided with the distribution.
#
# THIS SOFTWARE IS PROVIDED BY THE COPYRIGHT HOLDERS AND CONTRIBUTORS "AS IS" AND
# ANY EXPRESS OR IMPLIED WARRANTIES, INCLUDING, BUT NOT LIMITED TO, THE IMPLIED
# WARRANTIES OF MERCHANTABILITY AND FITNESS FOR A PARTICULAR PURPOSE ARE
# DISCLAIMED. IN NO EVENT SHALL THE COPYRIGHT OWNER OR CONTRIBUTORS BE LIABLE FOR
# ANY DIRECT, INDIRECT, INCIDENTAL, SPECIAL, EXEMPLARY, OR CONSEQUENTIAL DAMAGES
# (INCLUDING, BUT NOT LIMITED TO, PROCUREMENT OF SUBSTITUTE GOODS OR SERVICES;
# LOSS OF USE, DATA, OR PROFITS; OR BUSINESS INTERRUPTION) HOWEVER CAUSED AND
# ON ANY THEORY OF LIABILITY, WHETHER IN CONTRACT, STRICT LIABILITY, OR TORT
# (INCLUDING NEGLIGENCE OR OTHERWISE) ARISING IN ANY WAY OUT OF THE USE OF THIS
# SOFTWARE, EVEN IF ADVISED OF THE POSSIBILITY OF SUCH DAMAGE.

CONFIG_SHELL=y
CONFIG_FPU=y
CONFIG_NEWLIB_LIBC=y
CONFIG_NEWLIB_LIBC_FLOAT_PRINTF=y
CONFIG_CPLUSPLUS=y
CONFIG_STD_CPP2A=y
CONFIG_LIB_CPLUSPLUS=y
CONFIG_RTTI=y
CONFIG_RING_BUFFER=y
CONFIG_PRINTK=y
CONFIG_DISK_ACCESS=y
CONFIG_DISK_DRIVER_SDMMC=y
CONFIG_FILE_SYSTEM=y
CONFIG_FAT_FILESYSTEM_ELM=y
CONFIG_FS_FATFS_LFN=y
CONFIG_HEAP_MEM_POOL_SIZE=32768
CONFIG_FILE_SYSTEM_SHELL=y
CONFIG_LOG_STRDUP_MAX_STRING=64
CONFIG_LOG_STRDUP_BUF_COUNT=16
CONFIG_BOOTLOADER_MCUBOOT=y
CONFIG_MCUBOOT_SIGNATURE_KEY_FILE="bootloader/mcuboot/root-rsa-2048.pem"
CONFIG_MCUBOOT_GENERATE_CONFIRMED_IMAGE=y
CONFIG_FLASH=y
CONFIG_FLASH_MAP=y
CONFIG_REBOOT=y
CONFIG_CAN_STM32_OVERFLOW_DIAG=y
```

## src/main.cpp
```c
/*
 * Copyright (c) 2022, LexxPluss Inc.
 * All rights reserved.
 * 
 * Redistribution and use in source and binary forms, with or without
 * modification, are permitted provided that the following conditions are met:
 * 
 * 1. Redistributions of source code must retain the above copyright notice,
 *    this list of conditions and the following disclaimer.
 * 2. Redistributions in binary form must reproduce the above copyright notice,
 *    this list of conditions and the following disclaimer in the documentation
 *    and/or other materials provided with the distribution.
 * 
 * THIS SOFTWARE IS PROVIDED BY THE COPYRIGHT HOLDERS AND CONTRIBUTORS "AS IS" AND
 * ANY EXPRESS OR IMPLIED WARRANTIES, INCLUDING, BUT NOT LIMITED TO, THE IMPLIED
 * WARRANTIES OF MERCHANTABILITY AND FITNESS FOR A PARTICULAR PURPOSE ARE
 * DISCLAIMED. IN NO EVENT SHALL THE COPYRIGHT OWNER OR CONTRIBUTORS BE LIABLE FOR
 * ANY DIRECT, INDIRECT, INCIDENTAL, SPECIAL, EXEMPLARY, OR CONSEQUENTIAL DAMAGES
 * (INCLUDING, BUT NOT LIMITED TO, PROCUREMENT OF SUBSTITUTE GOODS OR SERVICES;
 * LOSS OF USE, DATA, OR PROFITS; OR BUSINESS INTERRUPTION) HOWEVER CAUSED AND
 * ON ANY THEORY OF LIABILITY, WHETHER IN CONTRACT, STRICT LIABILITY, OR TORT
 * (INCLUDING NEGLIGENCE OR OTHERWISE) ARISING IN ANY WAY OUT OF THE USE OF THIS
 * SOFTWARE, EVEN IF ADVISED OF THE POSSIBILITY OF SUCH DAMAGE.
 */

#include <zephyr.h>
#include <drivers/gpio.h>
#include "actuator_controller.hpp"
#include "adc_reader.hpp"
#include "can_controller.hpp"
#include "imu_controller.hpp"
#include "led_controller.hpp"
#include "misc_controller.hpp"
#include "pgv_controller.hpp"
#include "rosserial.hpp"
#include "rosserial_service.hpp"
#include "runaway_detector.hpp"
#include "tof_controller.hpp"
#include "uss_controller.hpp"

namespace {

K_THREAD_STACK_DEFINE(actuator_controller_stack, 2048);
K_THREAD_STACK_DEFINE(adc_reader_stack, 2048);
K_THREAD_STACK_DEFINE(can_controller_stack, 2048);
K_THREAD_STACK_DEFINE(imu_controller_stack, 2048);
K_THREAD_STACK_DEFINE(led_controller_stack, 2048);
K_THREAD_STACK_DEFINE(misc_controller_stack, 2048);
K_THREAD_STACK_DEFINE(pgv_controller_stack, 2048);
K_THREAD_STACK_DEFINE(rosserial_stack, 2048);
K_THREAD_STACK_DEFINE(rosserial_service_stack, 2048);
K_THREAD_STACK_DEFINE(runaway_detector_stack, 2048);
K_THREAD_STACK_DEFINE(tof_controller_stack, 2048);
K_THREAD_STACK_DEFINE(uss_controller_stack, 2048);

#define RUN(name, prio) \
    k_thread_create(&lexxhard::name::thread, name##_stack, K_THREAD_STACK_SIZEOF(name##_stack), \
                    lexxhard::name::run, nullptr, nullptr, nullptr, prio, K_FP_REGS, K_MSEC(2000));

void reset_usb_hub()
{
    if (const device *gpioa{device_get_binding("GPIOA")}; device_is_ready(gpioa)) {
        gpio_pin_configure(gpioa, 3, GPIO_OUTPUT_HIGH | GPIO_ACTIVE_HIGH);
        k_msleep(1);
        gpio_pin_set(gpioa, 3, 0);
        k_msleep(1);
        gpio_pin_set(gpioa, 3, 1);
    }
}

}

void main()
{
    reset_usb_hub();
    lexxhard::actuator_controller::init();
    lexxhard::adc_reader::init();
    lexxhard::can_controller::init();
    lexxhard::imu_controller::init();
    lexxhard::led_controller::init();
    lexxhard::misc_controller::init();
    lexxhard::pgv_controller::init();
    lexxhard::rosserial::init();
    lexxhard::rosserial_service::init();
    lexxhard::runaway_detector::init();
    lexxhard::tof_controller::init();
    lexxhard::uss_controller::init();
    RUN(actuator_controller, 2);
    RUN(adc_reader, 2);
    RUN(can_controller, 4);
    RUN(imu_controller, 2);
    RUN(led_controller, 1);
    RUN(misc_controller, 2);
    RUN(pgv_controller, 1);
    RUN(tof_controller, 2);
    RUN(uss_controller, 2);
    RUN(runaway_detector, 4);
    RUN(rosserial, 5); // The rosserial thread will be started last.
    RUN(rosserial_service, 6); // The rosserial thread will be started last.
    const device *gpiog{device_get_binding("GPIOG")};
    if (gpiog != nullptr)
        gpio_pin_configure(gpiog, 12, GPIO_OUTPUT_LOW | GPIO_ACTIVE_HIGH);
    int heartbeat_led{1};
    while (true) {
        if (gpiog != nullptr) {
            gpio_pin_set(gpiog, 12, heartbeat_led);
            heartbeat_led = !heartbeat_led;
        }
        k_msleep(1000);
    }
}

// vim: set expandtab shiftwidth=4:
```

## src/actuator_controller.hpp
```c
/*
 * Copyright (c) 2022, LexxPluss Inc.
 * All rights reserved.
 *
 * Redistribution and use in source and binary forms, with or without
 * modification, are permitted provided that the following conditions are met:
 *
 * 1. Redistributions of source code must retain the above copyright notice,
 *    this list of conditions and the following disclaimer.
 * 2. Redistributions in binary form must reproduce the above copyright notice,
 *    this list of conditions and the following disclaimer in the documentation
 *    and/or other materials provided with the distribution.
 *
 * THIS SOFTWARE IS PROVIDED BY THE COPYRIGHT HOLDERS AND CONTRIBUTORS "AS IS" AND
 * ANY EXPRESS OR IMPLIED WARRANTIES, INCLUDING, BUT NOT LIMITED TO, THE IMPLIED
 * WARRANTIES OF MERCHANTABILITY AND FITNESS FOR A PARTICULAR PURPOSE ARE
 * DISCLAIMED. IN NO EVENT SHALL THE COPYRIGHT OWNER OR CONTRIBUTORS BE LIABLE FOR
 * ANY DIRECT, INDIRECT, INCIDENTAL, SPECIAL, EXEMPLARY, OR CONSEQUENTIAL DAMAGES
 * (INCLUDING, BUT NOT LIMITED TO, PROCUREMENT OF SUBSTITUTE GOODS OR SERVICES;
 * LOSS OF USE, DATA, OR PROFITS; OR BUSINESS INTERRUPTION) HOWEVER CAUSED AND
 * ON ANY THEORY OF LIABILITY, WHETHER IN CONTRACT, STRICT LIABILITY, OR TORT
 * (INCLUDING NEGLIGENCE OR OTHERWISE) ARISING IN ANY WAY OUT OF THE USE OF THIS
 * SOFTWARE, EVEN IF ADVISED OF THE POSSIBILITY OF SUCH DAMAGE.
 */

#pragma once

#include <zephyr.h>

namespace lexxhard::actuator_controller {

struct msg_control {
    struct {
        int8_t direction;
        uint8_t power;
    } actuators[3];
    static constexpr int8_t DOWN{-1}, STOP{0}, UP{1};
} __attribute__((aligned(4)));

struct msg {
    int32_t encoder_count[3];
    int32_t current[3];
    int32_t connect;
    bool fail[3];
} __attribute__((aligned(4)));

void init();
void run(void *p1, void *p2, void *p3);
int init_location(const int8_t (&directoins)[3]);
int to_location(const uint8_t (&location)[3], const uint8_t (&power)[3], uint8_t (&detail)[3]);
extern k_thread thread;
extern k_msgq msgq, msgq_control;

}

// vim: set expandtab shiftwidth=4:
```

## src/can_controller.hpp
```c
/*
 * Copyright (c) 2022, LexxPluss Inc.
 * All rights reserved.
 *
 * Redistribution and use in source and binary forms, with or without
 * modification, are permitted provided that the following conditions are met:
 *
 * 1. Redistributions of source code must retain the above copyright notice,
 *    this list of conditions and the following disclaimer.
 * 2. Redistributions in binary form must reproduce the above copyright notice,
 *    this list of conditions and the following disclaimer in the documentation
 *    and/or other materials provided with the distribution.
 *
 * THIS SOFTWARE IS PROVIDED BY THE COPYRIGHT HOLDERS AND CONTRIBUTORS "AS IS" AND
 * ANY EXPRESS OR IMPLIED WARRANTIES, INCLUDING, BUT NOT LIMITED TO, THE IMPLIED
 * WARRANTIES OF MERCHANTABILITY AND FITNESS FOR A PARTICULAR PURPOSE ARE
 * DISCLAIMED. IN NO EVENT SHALL THE COPYRIGHT OWNER OR CONTRIBUTORS BE LIABLE FOR
 * ANY DIRECT, INDIRECT, INCIDENTAL, SPECIAL, EXEMPLARY, OR CONSEQUENTIAL DAMAGES
 * (INCLUDING, BUT NOT LIMITED TO, PROCUREMENT OF SUBSTITUTE GOODS OR SERVICES;
 * LOSS OF USE, DATA, OR PROFITS; OR BUSINESS INTERRUPTION) HOWEVER CAUSED AND
 * ON ANY THEORY OF LIABILITY, WHETHER IN CONTRACT, STRICT LIABILITY, OR TORT
 * (INCLUDING NEGLIGENCE OR OTHERWISE) ARISING IN ANY WAY OUT OF THE USE OF THIS
 * SOFTWARE, EVEN IF ADVISED OF THE POSSIBILITY OF SUCH DAMAGE.
 */

#pragma once

#include <zephyr.h>

namespace lexxhard::can_controller {

struct msg_bmu {
    struct {
        uint16_t value;
        uint8_t id;
    } max_voltage, min_voltage, max_cell_voltage, min_cell_voltage;
    struct {
        int16_t value;
        uint8_t id;
    } max_temp, min_temp, max_current, min_current;
    int16_t fet_temp, pack_current;
    uint16_t charging_current, pack_voltage, design_capacity, full_charge_capacity, remain_capacity;
    uint16_t manufacturing, inspection, serial;
    uint8_t mod_status1, mod_status2, bmu_status, asoc, rsoc, soh;
    uint8_t bmu_fw_ver, mod_fw_ver, serial_config, parallel_config, bmu_alarm1, bmu_alarm2;
} __attribute__((aligned(4)));

struct msg_board {
    float main_board_temp, actuator_board_temp[3], charge_connector_voltage;
    int16_t charge_connector_temp[2], power_board_temp;
    uint8_t fan_duty, shutdown_reason, state, charge_check_count, charge_heartbeat_delay;
    bool bumper_switch[2];
    bool emergency_switch[2];
    bool power_switch, wait_shutdown, auto_charging, manual_charging;
    bool c_fet, d_fet, p_dsg, v5_fail, v16_fail;
    bool wheel_disable[2];
    bool charge_temperature_error;
} __attribute__((aligned(4)));

struct msg_control {
    bool emergency_stop, power_off, wheel_power_off, lockdown;
} __attribute__((aligned(4)));

// msg_diagnostics only support can msg length failure for now
struct msg_diagnostics {
    uint16_t cob_id;
    uint8_t dlc;
} __attribute__((aligned(4)));

void init();
void run(void *p1, void *p2, void *p3);
uint32_t get_rsoc();
bool get_emergency_switch();
bool get_bumper_switch();
bool is_emergency();
extern k_thread thread;
extern k_msgq msgq_bmu, msgq_board, msgq_control, msgq_diagnostics;

}

// vim: set expandtab shiftwidth=4:
```

## src/imu_controller.cpp
```c
/*
 * Copyright (c) 2022, LexxPluss Inc.
 * All rights reserved.
 * 
 * Redistribution and use in source and binary forms, with or without
 * modification, are permitted provided that the following conditions are met:
 * 
 * 1. Redistributions of source code must retain the above copyright notice,
 *    this list of conditions and the following disclaimer.
 * 2. Redistributions in binary form must reproduce the above copyright notice,
 *    this list of conditions and the following disclaimer in the documentation
 *    and/or other materials provided with the distribution.
 * 
 * THIS SOFTWARE IS PROVIDED BY THE COPYRIGHT HOLDERS AND CONTRIBUTORS "AS IS" AND
 * ANY EXPRESS OR IMPLIED WARRANTIES, INCLUDING, BUT NOT LIMITED TO, THE IMPLIED
 * WARRANTIES OF MERCHANTABILITY AND FITNESS FOR A PARTICULAR PURPOSE ARE
 * DISCLAIMED. IN NO EVENT SHALL THE COPYRIGHT OWNER OR CONTRIBUTORS BE LIABLE FOR
 * ANY DIRECT, INDIRECT, INCIDENTAL, SPECIAL, EXEMPLARY, OR CONSEQUENTIAL DAMAGES
 * (INCLUDING, BUT NOT LIMITED TO, PROCUREMENT OF SUBSTITUTE GOODS OR SERVICES;
 * LOSS OF USE, DATA, OR PROFITS; OR BUSINESS INTERRUPTION) HOWEVER CAUSED AND
 * ON ANY THEORY OF LIABILITY, WHETHER IN CONTRACT, STRICT LIABILITY, OR TORT
 * (INCLUDING NEGLIGENCE OR OTHERWISE) ARISING IN ANY WAY OUT OF THE USE OF THIS
 * SOFTWARE, EVEN IF ADVISED OF THE POSSIBILITY OF SUCH DAMAGE.
 */

#include <device.h>
#include <drivers/sensor.h>
#include <logging/log.h>
#include <shell/shell.h>
#include "imu_controller.hpp"
#include "runaway_detector.hpp"

namespace lexxhard::imu_controller {

LOG_MODULE_REGISTER(imu);

char __aligned(4) msgq_buffer[8 * sizeof (msg)];

class {
public:
    int init() {
        k_msgq_init(&msgq, msgq_buffer, sizeof (msg), 8);
        dev = device_get_binding("ADIS16470");
        if (!device_is_ready(dev))
            return -1;
        for (int i{0}; i < 3; ++i) {
            message.accel[i] = 0;
            message.gyro[i] = 0;
            message.delta_ang[i] = 0;
            message.delta_vel[i] = 0;
        }
        message.temp = 0;
        LOG_INF("IMU controller for LexxPluss board. (%p)", dev);
        return 0;
    }
    void run() {
        if (!device_is_ready(dev))
            return;
        while (true) {
            if (sensor_sample_fetch_chan(dev, SENSOR_CHAN_ALL) == 0) {
                message.accel[0] = get_sensor_value_as_float(SENSOR_CHAN_ACCEL_X);
                message.accel[1] = get_sensor_value_as_float(SENSOR_CHAN_ACCEL_Y);
                message.accel[2] = get_sensor_value_as_float(SENSOR_CHAN_ACCEL_Z);
                message.gyro[0] = get_sensor_value_as_float(SENSOR_CHAN_GYRO_X);
                message.gyro[1] = get_sensor_value_as_float(SENSOR_CHAN_GYRO_Y);
                message.gyro[2] = get_sensor_value_as_float(SENSOR_CHAN_GYRO_Z);
                message.temp = get_sensor_value_as_float(SENSOR_CHAN_DIE_TEMP);
                message.delta_ang[0] = get_sensor_value_as_float(SENSOR_CHAN_PRIV_START);
                message.delta_ang[1] = get_sensor_value_as_float(SENSOR_CHAN_PRIV_START, 1);
                message.delta_ang[2] = get_sensor_value_as_float(SENSOR_CHAN_PRIV_START, 2);
                message.delta_vel[0] = get_sensor_value_as_float(SENSOR_CHAN_PRIV_START, 3);
                message.delta_vel[1] = get_sensor_value_as_float(SENSOR_CHAN_PRIV_START, 4);
                message.delta_vel[2] = get_sensor_value_as_float(SENSOR_CHAN_PRIV_START, 5);
                while (k_msgq_put(&msgq, &message, K_NO_WAIT) != 0)
                    k_msgq_purge(&msgq);
                runaway_detector::msg message_runaway{
                    .accel{message.accel[0], message.accel[1], message.accel[2]},
                    .gyro{message.gyro[0], message.gyro[1], message.gyro[2]}
                };
                while (k_msgq_put(&runaway_detector::msgq, &message_runaway, K_NO_WAIT) != 0)
                    k_msgq_purge(&runaway_detector::msgq);
            }
            k_msleep(1);
        }
    }
    void info(const shell *shell) {
        msg m{message};
        shell_print(shell,
                    "accel: %f %f %f (m/s/s)\n"
                    "gyro: %f %f %f (deg/s)\n"
                    "vel: %f %f %f (m/s)\n"
                    "ang: %f %f %f (deg)\n"
                    "temp: %fdeg",
                    m.accel[0], m.accel[1], m.accel[2],
                    m.gyro[0], m.gyro[1], m.gyro[2],
                    m.delta_vel[0], m.delta_vel[1], m.delta_vel[2],
                    m.delta_ang[0], m.delta_ang[1], m.delta_ang[2],
                    m.temp);
    }
private:
    float get_sensor_value_as_float(enum sensor_channel chan, uint32_t offset) const {
        chan = static_cast<enum sensor_channel>(static_cast<uint32_t>(chan) + offset);
        return get_sensor_value_as_float(chan);
    }
    float get_sensor_value_as_float(enum sensor_channel chan) const {
        sensor_value v;
        sensor_channel_get(dev, chan, &v);
        return static_cast<float>(v.val1) + static_cast<float>(v.val2) * 1e-6f;
    }
    const device *dev{nullptr};
    msg message;
} impl;

int info(const shell *shell, size_t argc, char **argv)
{
    impl.info(shell);
    return 0;
}

SHELL_STATIC_SUBCMD_SET_CREATE(sub,
    SHELL_CMD(info, NULL, "IMU information", info),
    SHELL_SUBCMD_SET_END
);
SHELL_CMD_REGISTER(imu, &sub, "IMU commands", NULL);

void init()
{
    impl.init();
}

void run(void *p1, void *p2, void *p3)
{
    impl.run();
}

k_thread thread;
k_msgq msgq;

}

// vim: set expandtab shiftwidth=4:
```

## src/led_controller.cpp
```c
/*
 * Copyright (c) 2022, LexxPluss Inc.
 * All rights reserved.
 *
 * Redistribution and use in source and binary forms, with or without
 * modification, are permitted provided that the following conditions are met:
 *
 * 1. Redistributions of source code must retain the above copyright notice,
 *    this list of conditions and the following disclaimer.
 * 2. Redistributions in binary form must reproduce the above copyright notice,
 *    this list of conditions and the following disclaimer in the documentation
 *    and/or other materials provided with the distribution.
 *
 * THIS SOFTWARE IS PROVIDED BY THE COPYRIGHT HOLDERS AND CONTRIBUTORS "AS IS" AND
 * ANY EXPRESS OR IMPLIED WARRANTIES, INCLUDING, BUT NOT LIMITED TO, THE IMPLIED
 * WARRANTIES OF MERCHANTABILITY AND FITNESS FOR A PARTICULAR PURPOSE ARE
 * DISCLAIMED. IN NO EVENT SHALL THE COPYRIGHT OWNER OR CONTRIBUTORS BE LIABLE FOR
 * ANY DIRECT, INDIRECT, INCIDENTAL, SPECIAL, EXEMPLARY, OR CONSEQUENTIAL DAMAGES
 * (INCLUDING, BUT NOT LIMITED TO, PROCUREMENT OF SUBSTITUTE GOODS OR SERVICES;
 * LOSS OF USE, DATA, OR PROFITS; OR BUSINESS INTERRUPTION) HOWEVER CAUSED AND
 * ON ANY THEORY OF LIABILITY, WHETHER IN CONTRACT, STRICT LIABILITY, OR TORT
 * (INCLUDING NEGLIGENCE OR OTHERWISE) ARISING IN ANY WAY OUT OF THE USE OF THIS
 * SOFTWARE, EVEN IF ADVISED OF THE POSSIBILITY OF SUCH DAMAGE.
 */

#include <device.h>
#include <devicetree.h>
#include <drivers/led_strip.h>
#include <logging/log.h>
#include <shell/shell.h>
#include <algorithm>
#include <cstdlib>
#include "can_controller.hpp"
#include "led_controller.hpp"

namespace lexxhard::led_controller {

LOG_MODULE_REGISTER(led);

char __aligned(4) msgq_buffer[8 * sizeof (msg)];

class led_message_receiver {
public:
    led_message_receiver() {
        message.pattern = msg::SHOWTIME;
        message.interrupt_ms = 0;
    }
    bool get_message(msg &output) {
        bool updated{false};
        if (msg message_new; k_msgq_get(&msgq, &message_new, K_MSEC(DELAY_MS)) == 0) {
            if (message.interrupt_ms > 0) {
                if (message_new.interrupt_ms == 0) {
                    message_interrupted = message_new;
                }
            } else {
                if (is_new_message(message_new)) {
                    if (message_new.interrupt_ms > 0) {
                        LOG_INF("interrupted pattern %u %ums", message_new.pattern, message_new.interrupt_ms);
                        message_interrupted = message;
                        cycle_interrupted = k_cycle_get_32();
                    }
                    message = message_new;
                    updated = true;
                }
            }
        }
        if (message.interrupt_ms > 0) {
            uint32_t delta_ms{k_cyc_to_ms_near32(k_cycle_get_32() - cycle_interrupted)};
            if (delta_ms > message.interrupt_ms) {
                message = message_interrupted;
                message.interrupt_ms = 0;
                updated = true;
            }
        }
        output = message;
        return updated;
    }
    static constexpr uint32_t DELAY_MS{25};
private:
    bool is_new_message(const msg &message_new) const {
        if (message_new.pattern != message.pattern)
            return true;
        if (message_new.pattern == msg::RGB ||
            message_new.pattern == msg::RGB_BLINK ||
            message_new.pattern == msg::RGB_BREATH) {
            if (message_new.cpm != message.cpm ||
                message_new.rgb[0] != message.rgb[0] ||
                message_new.rgb[1] != message.rgb[1] ||
                message_new.rgb[2] != message.rgb[2])
                return true;
        }
        return false;
    }
    msg message, message_interrupted;
    uint32_t cycle_interrupted{0};
};

class led_controller_impl {
public:
    int init() {
        k_msgq_init(&msgq, msgq_buffer, sizeof (msg), 8);
        dev[LED_LEFT] = device_get_binding("WS2812_0");
        dev[LED_RIGHT] = device_get_binding("WS2812_1");
        dev[2] = device_get_binding("WS2812_3");
        dev[3] = device_get_binding("WS2812_2");
        if (!device_is_ready(dev[LED_LEFT]) || !device_is_ready(dev[LED_RIGHT]) ||
            !device_is_ready(dev[2]) || !device_is_ready(dev[3]))
            return -1;
        fill(black);
        update();
        return 0;
    }
    void run() {
        if (!device_is_ready(dev[LED_LEFT]) || !device_is_ready(dev[LED_RIGHT]) ||
            !device_is_ready(dev[2]) || !device_is_ready(dev[3]))
            return;
        while (true) {
            msg message;
            if (rec.get_message(message))
                counter = 0;
            poll(message);
        }
    }
private:
    void poll(const msg &message) {
        switch (message.pattern) {
        default:
        case msg::NONE:            fill(black); break;
        case msg::SAFETY_PAUSE:  fill_strobe(safety_pause, 10, 50, 1000); break;
        case msg::AMR_MODE:        fill(amr_mode); break;
        case msg::AGV_MODE:        fill(agv_mode); break;
        case msg::MISSION_PAUSE:   fill(mission_pause); break;
        case msg::PATH_BLOCKED:    fill(path_blocked); break;
        case msg::MANUAL_DRIVE:    fill(manual_drive); break;
        case msg::CHARGING:        fill_rainbow(); break;
        case msg::WAITING_FOR_JOB: fill_fade(waiting_for_job, 9); break;
        case msg::LEFT_WINKER:     fill_blink_sequence(sequence, LED_LEFT); break;
        case msg::RIGHT_WINKER:    fill_blink_sequence(sequence, LED_RIGHT); break;
        case msg::BOTH_WINKER:     fill_blink_sequence(sequence, LED_BOTH); break;
        case msg::MOVE_ACTUATOR:   fill_strobe(move_actuator, 10, 200, 200); break;
        case msg::CHARGE_LEVEL:    fill_charge_level(); break;
        case msg::SHOWTIME:        fill_knight_industries_two_thousand(); break;
        case msg::LOCKDOWN:        fill_strobe(lockdown, 10, 200, 0); break;
        case msg::RGB:             fill(led_rgb{.r{message.rgb[0]}, .g{message.rgb[1]}, .b{message.rgb[2]}}); break;
        case msg::RGB_BLINK:       fill_blink(led_rgb{.r{message.rgb[0]}, .g{message.rgb[1]}, .b{message.rgb[2]}}, message.cpm); break;
        case msg::RGB_BREATH:      fill_fade(led_rgb{.r{message.rgb[0]}, .g{message.rgb[1]}, .b{message.rgb[2]}}, message.cpm);break;
        }
        clamp();
        update();
        ++counter;
    }
    led_rgb clamp_rgb(led_rgb rgb) const {
        auto const max_channel_value{std::max({rgb.r, rgb.g, rgb.b})};
        auto const acc_channel_value(static_cast<float>(rgb.r) + static_cast<float>(rgb.g) + static_cast<float>(rgb.b));

        auto const channel_wise_ratio{static_cast<float>(clamp_threshold) / max_channel_value};
        auto const agg_ratio{3 * static_cast<float>(clamp_threshold) / acc_channel_value};
        auto const clamp_ratio = std::min(channel_wise_ratio, agg_ratio);
        if (1.0f <= clamp_ratio) {
            return rgb;
        }

        return led_rgb{
            .r=static_cast<uint8_t>(clamp_ratio * rgb.r + 0.5f),
            .g=static_cast<uint8_t>(clamp_ratio * rgb.g + 0.5f),
            .b=static_cast<uint8_t>(clamp_ratio * rgb.b + 0.5f)
        };
    }
    void clamp() {
        for (uint32_t i{0}; i < PIXELS; ++i) {
            pixeldata[LED_LEFT][i] = clamp_rgb(pixeldata[LED_LEFT][i]);
            pixeldata[LED_RIGHT][i] = clamp_rgb(pixeldata[LED_RIGHT][i]);
        }
    }
    void update() {
        std::copy(&pixeldata[LED_LEFT][0],  &pixeldata[LED_LEFT][PIXELS_BACK],  &pixeldata_back[LED_LEFT][0]);
        std::copy(&pixeldata[LED_RIGHT][0], &pixeldata[LED_RIGHT][PIXELS_BACK], &pixeldata_back[LED_RIGHT][0]);
        if (can_controller::is_emergency()) {
            static uint32_t blink_counter{0};
            ++blink_counter;
            if (blink_counter < 20) {
                led_rgb red{.r{0xff}, .g{0x00}, .b{0x00}};
                for (uint32_t i{PIXELS_BACK - 4}; i < PIXELS_BACK; ++i)
                    pixeldata_back[LED_LEFT][i] = pixeldata_back[LED_RIGHT][i] = red;
            } else if (blink_counter >= 40) {
                blink_counter = 0;
            }
        }
        led_strip_update_rgb(dev[LED_LEFT], pixeldata[LED_LEFT], PIXELS);
        led_strip_update_rgb(dev[LED_RIGHT], pixeldata[LED_RIGHT], PIXELS);
        led_strip_update_rgb(dev[2], pixeldata_back[LED_LEFT], PIXELS_BACK);
        led_strip_update_rgb(dev[3], pixeldata_back[LED_RIGHT], PIXELS_BACK);
    }
    void fill(const led_rgb &color, uint32_t select = LED_BOTH) {
        if (select == LED_BOTH) {
            for (uint32_t i{0}; i < PIXELS; ++i)
                pixeldata[LED_LEFT][i] = pixeldata[LED_RIGHT][i] = color;
        } else {
            for (uint32_t i{0}; i < PIXELS; ++i)
                pixeldata[select][i] = color;
        }
    }
    void fill_strobe(const led_rgb &color, uint32_t nstrobe, uint32_t strobedelay, uint32_t endpause) {
        static constexpr auto delay{led_message_receiver::DELAY_MS};
        if (counter < nstrobe * strobedelay / delay) {
            if ((counter % (strobedelay * 2 / delay)) == 0)
                fill(color);
            else if ((counter % (strobedelay * 2 / delay)) == strobedelay / delay)
                fill(black);
        } else if (counter == (nstrobe * strobedelay + endpause) / delay) {
            fill(black);
            counter = 0;
        }
    }
    void fill_rainbow(uint32_t select = LED_BOTH) {
        if (counter % 3 == 0)
            return;
        if (counter > 256 * 3)
            counter = 0;
        if (select == LED_BOTH) {
            for (uint32_t i{0}; i < PIXELS; ++i)
                pixeldata[LED_LEFT][i] = pixeldata[LED_RIGHT][i] = wheel(((i * 256 / PIXELS) + counter / 3) & 255);
        } else {
            for (uint32_t i{0}; i < PIXELS; ++i)
                pixeldata[select][i] = wheel(((i * 256 / PIXELS) + counter / 3) & 255);
        }
    }
    void fill_fade(const led_rgb &color, uint32_t count_per_min) {
        uint32_t hz{1000 / led_message_receiver::DELAY_MS};
        uint32_t thres{60 * hz / count_per_min};
        if (counter >= thres)
            counter = 0;
        int percent;
        if (counter < thres / 2)
            percent = counter * 100 / (thres / 2);
        else
            percent = (thres - counter) * 100 / (thres / 2);
        fill(fader(color, percent));
    }
    void fill_blink(const led_rgb &color, int count_per_min) {
        uint32_t hz{1000 / led_message_receiver::DELAY_MS};
        uint32_t thres{60 * hz / count_per_min};
        if (counter >= thres)
            counter = 0;
        fill(counter < thres / 2 ? color : black);
    }
    void fill_blink_sequence(const led_rgb &color, uint32_t select = LED_BOTH) {
        uint32_t n{0};
        if (counter >= 8 && counter < 25) {
            n = (counter - 8) * 6;
            if (n > PIXELS)
                n = PIXELS;
        }
        if (select == LED_BOTH) {
            for (uint32_t i{0}; i < PIXELS; ++i)
                pixeldata[LED_LEFT][i] = pixeldata[LED_RIGHT][i] = i < n ? color : black;
        } else {
            for (uint32_t i{0}; i < PIXELS; ++i)
                pixeldata[select][i] = i < n ? color : black;
            fill(black, select == LED_LEFT ? LED_RIGHT : LED_LEFT);
        }
        if (counter > 25)
            counter = 0;
    }
    void fill_toggle(const led_rgb &color) {
        static constexpr uint32_t thres{5};
        if (counter >= thres * 2)
            counter = 0;
        led_rgb c0, c1;
        if (counter < thres)
            c0 = color, c1 = black;
        else
            c0 = black, c1 = color;
        for (uint32_t i{0}; i < PIXELS; ++i) {
            if (i % 2 == 0)
                pixeldata[LED_LEFT][i] = pixeldata[LED_RIGHT][i] = c0;
            else
                pixeldata[LED_LEFT][i] = pixeldata[LED_RIGHT][i] = c1;
        }
    }
    void fill_charge_level() {
        static constexpr uint32_t thres{40};
        if (counter >= thres * 2)
            counter = 0;
        uint32_t head;
        if (counter >= thres)
            head = 0;
        else
            head = PIXELS - (PIXELS * counter / thres);
        static constexpr led_rgb color{.r{0xff}, .g{0x20}, .b{0x00}};
        uint32_t rsoc{can_controller::get_rsoc()};
        uint32_t n;
        if (rsoc < 100) {
            n = PIXELS - (PIXELS * rsoc / 100U);
            if (n < head)
                n = head;
        } else {
            n = head;
        }
        for (uint32_t i{0}; i < PIXELS; ++i)
            pixeldata[LED_LEFT][i] = pixeldata[LED_RIGHT][i] = i < n ? black : color;
    }
    void fill_knight_industries_two_thousand() {
        static constexpr int32_t width{20};
        if (counter >= (PIXELS + width) * 2)
            counter = 0;
        bool back{counter >= PIXELS + width};
        int32_t pos;
        if (back)
            pos = (PIXELS + width) * 2 - counter - width;
        else
            pos = counter;
        for (int32_t i{0}, end{PIXELS}; i < end; ++i) {
            bool no_color;
            if (back)
                no_color = i < pos || i > pos + width;
            else
                no_color = i < pos - width || i > pos;
            if (no_color) {
                pixeldata[LED_LEFT][i] = pixeldata[LED_RIGHT][i] = black;
            } else {
                static constexpr led_rgb color{.r{0x00}, .g{0x80}, .b{0x20}};
                int gain{(width - abs(pos - i)) * 100 / width};
                gain = gain * gain * gain / 100 / 100;
                led_rgb dimmed{fader(color, gain)};
                pixeldata[LED_LEFT][i] = pixeldata[LED_RIGHT][i] = dimmed;
            }
        }
    }
    led_rgb fader(const led_rgb &color, int percent) const {
        led_rgb color_;
        color_.r = color.r * percent / 100;
        color_.g = color.g * percent / 100;
        color_.b = color.b * percent / 100;
        return color_;
    }
    led_rgb wheel(uint32_t wheelpos) const {
        static constexpr uint32_t thres{256 / 3};
        led_rgb color;
        if (wheelpos < thres) {
            color.r = wheelpos * 3;
            color.g = 255 - wheelpos * 3;
            color.b = 0;
        } else if (wheelpos < thres * 2) {
            wheelpos -= thres;
            color.r = 255 - wheelpos * 3;
            color.g = 0;
            color.b = wheelpos * 3;
        } else {
            wheelpos -= thres * 2;
            color.r = 0;
            color.g = wheelpos * 3;
            color.b = 255 - wheelpos * 3;
        }
        return color;
    }
    led_message_receiver rec;
    static constexpr uint32_t PIXELS{DT_PROP(DT_NODELABEL(led_strip0), chain_length)};
    static constexpr uint32_t PIXELS_BACK{DT_PROP(DT_NODELABEL(led_strip2), chain_length)};
    static constexpr uint32_t LED_LEFT{0}, LED_RIGHT{1}, LED_BOTH{2};
    const device *dev[4]{nullptr, nullptr, nullptr, nullptr};
    led_rgb pixeldata[2][PIXELS], pixeldata_back[2][PIXELS_BACK];
    uint32_t counter{0};
    static constexpr uint8_t clamp_threshold{0x80};
    static const led_rgb safety_pause, amr_mode, agv_mode, mission_pause, path_blocked, manual_drive;
    static const led_rgb dock_mode, waiting_for_job, orange, sequence, move_actuator, lockdown, black;
} impl;
const led_rgb led_controller_impl::safety_pause {.r{0x80}, .g{0x00}, .b{0x00}};
const led_rgb led_controller_impl::amr_mode       {.r{0x00}, .g{0x80}, .b{0x80}};
const led_rgb led_controller_impl::agv_mode       {.r{0x45}, .g{0xff}, .b{0x00}};
const led_rgb led_controller_impl::mission_pause  {.r{0xff}, .g{0xff}, .b{0x00}};
const led_rgb led_controller_impl::path_blocked   {.r{0xe6}, .g{0x08}, .b{0xff}};
const led_rgb led_controller_impl::manual_drive   {.r{0xfe}, .g{0xf4}, .b{0xff}};
const led_rgb led_controller_impl::dock_mode      {.r{0x00}, .g{0x00}, .b{0xff}};
const led_rgb led_controller_impl::waiting_for_job{.r{0xff}, .g{0xff}, .b{0x00}};
const led_rgb led_controller_impl::orange         {.r{0xff}, .g{0xa5}, .b{0x00}};
const led_rgb led_controller_impl::sequence       {.r{0x90}, .g{0x20}, .b{0x00}};
const led_rgb led_controller_impl::move_actuator  {.r{0x45}, .g{0xff}, .b{0x00}};
const led_rgb led_controller_impl::lockdown       {.r{0x00}, .g{0x00}, .b{0x80}};
const led_rgb led_controller_impl::black          {.r{0x00}, .g{0x00}, .b{0x00}};

int pattern(const shell *shell, size_t argc, char **argv)
{
    if (argc != 2) {
        shell_error(shell, "Usage: %s %s <pattern>\n", argv[-1], argv[0]);
        return 1;
    }
    msg message{argv[1]};
    while (k_msgq_put(&msgq, &message, K_NO_WAIT) != 0)
        k_msgq_purge(&msgq);
    return 0;
}

int color(const shell *shell, size_t argc, char **argv)
{
    if (argc != 4) {
        shell_error(shell, "Usage: %s %s <r> <g> <b>\n", argv[-1], argv[0]);
        return 1;
    }
    msg message{msg::RGB, 0};
    message.rgb[0] = atoi(argv[1]);
    message.rgb[1] = atoi(argv[2]);
    message.rgb[2] = atoi(argv[3]);
    while (k_msgq_put(&msgq, &message, K_NO_WAIT) != 0)
        k_msgq_purge(&msgq);
    return 0;
}

SHELL_STATIC_SUBCMD_SET_CREATE(sub,
    SHELL_CMD(pattern, NULL, "LED pattern command", pattern),
    SHELL_CMD(color, NULL, "LED color command", color),
    SHELL_SUBCMD_SET_END
);
SHELL_CMD_REGISTER(led, &sub, "LED commands", NULL);

void init()
{
    impl.init();
}

void run(void *p1, void *p2, void *p3)
{
    impl.run();
}

k_thread thread;
k_msgq msgq;

}

// vim: set expandtab shiftwidth=4:
```

## src/led_controller.hpp
```c
/*
 * Copyright (c) 2022, LexxPluss Inc.
 * All rights reserved.
 *
 * Redistribution and use in source and binary forms, with or without
 * modification, are permitted provided that the following conditions are met:
 *
 * 1. Redistributions of source code must retain the above copyright notice,
 *    this list of conditions and the following disclaimer.
 * 2. Redistributions in binary form must reproduce the above copyright notice,
 *    this list of conditions and the following disclaimer in the documentation
 *    and/or other materials provided with the distribution.
 *
 * THIS SOFTWARE IS PROVIDED BY THE COPYRIGHT HOLDERS AND CONTRIBUTORS "AS IS" AND
 * ANY EXPRESS OR IMPLIED WARRANTIES, INCLUDING, BUT NOT LIMITED TO, THE IMPLIED
 * WARRANTIES OF MERCHANTABILITY AND FITNESS FOR A PARTICULAR PURPOSE ARE
 * DISCLAIMED. IN NO EVENT SHALL THE COPYRIGHT OWNER OR CONTRIBUTORS BE LIABLE FOR
 * ANY DIRECT, INDIRECT, INCIDENTAL, SPECIAL, EXEMPLARY, OR CONSEQUENTIAL DAMAGES
 * (INCLUDING, BUT NOT LIMITED TO, PROCUREMENT OF SUBSTITUTE GOODS OR SERVICES;
 * LOSS OF USE, DATA, OR PROFITS; OR BUSINESS INTERRUPTION) HOWEVER CAUSED AND
 * ON ANY THEORY OF LIABILITY, WHETHER IN CONTRACT, STRICT LIABILITY, OR TORT
 * (INCLUDING NEGLIGENCE OR OTHERWISE) ARISING IN ANY WAY OUT OF THE USE OF THIS
 * SOFTWARE, EVEN IF ADVISED OF THE POSSIBILITY OF SUCH DAMAGE.
 */

#pragma once

#include <zephyr.h>
#include <cstdlib>
#include <cstring>

namespace lexxhard::led_controller {

struct msg {
    msg() : pattern(NONE), interrupt_ms(0) {}
    msg(uint32_t pattern, uint32_t interrupt_ms) :
        pattern(pattern), interrupt_ms(interrupt_ms) {}
    msg(const char *str) {
        if      (strcmp(str, "safety_pause")  == 0) pattern = SAFETY_PAUSE;
        else if (strcmp(str, "amr_mode")        == 0) pattern = AMR_MODE;
        else if (strcmp(str, "agv_mode")        == 0) pattern = AGV_MODE;
        else if (strcmp(str, "mission_pause")   == 0) pattern = MISSION_PAUSE;
        else if (strcmp(str, "path_blocked")    == 0) pattern = PATH_BLOCKED;
        else if (strcmp(str, "manual_drive")    == 0) pattern = MANUAL_DRIVE;
        else if (strcmp(str, "charging")        == 0) pattern = CHARGING;
        else if (strcmp(str, "waiting_for_job") == 0) pattern = WAITING_FOR_JOB;
        else if (strcmp(str, "left_winker")     == 0) pattern = LEFT_WINKER;
        else if (strcmp(str, "right_winker")    == 0) pattern = RIGHT_WINKER;
        else if (strcmp(str, "both_winker")     == 0) pattern = BOTH_WINKER;
        else if (strcmp(str, "move_actuator")   == 0) pattern = MOVE_ACTUATOR;
        else if (strcmp(str, "charge_level")    == 0) pattern = CHARGE_LEVEL;
        else if (strcmp(str, "showtime")        == 0) pattern = SHOWTIME;
        else if (strcmp(str, "lockdown")        == 0) pattern = LOCKDOWN;
        else if (*str == '#') setup_cpm_breath(str);
        else pattern = NONE;
        interrupt_ms = 0;
    }
    void setup_cpm_breath(const char *str) {
        pattern = NONE;
        cpm = 0;
        int r{dec2(&str[1])};
        int g{dec2(&str[3])};
        int b{dec2(&str[5])};
        if (r < 0 || g < 0 || b < 0)
            return;
        rgb[0] = r;
        rgb[1] = g;
        rgb[2] = b;
        if (str[7] != ' ')
            return;
        if (strncmp(&str[8], "breath", 6) == 0 && str[14] == ' ') {
            pattern = RGB_BREATH;
            cpm = atoi(&str[15]);
        } else if (strncmp(&str[8], "blink", 5) == 0 && str[13] == ' ') {
            pattern = RGB_BLINK;
            cpm = atoi(&str[14]);
        } else {
            return;
        }
        if (cpm == 0)
            pattern = RGB;
    }
    int dec2(const char *str) const {
        int h{dec1(str[0])};
        int l{dec1(str[1])};
        if (h < 0 || l < 0)
            return -1;
        return h << 4 | l;
    }
    int dec1(char c) const {
        return (c >= '0' && c <= '9') ? c - '0'
             : (c >= 'a' && c <= 'f') ? c - 'a' + 10
             : (c >= 'A' && c <= 'F') ? c - 'A' + 10
                                      : -1;
    }
    uint32_t pattern{NONE}, interrupt_ms{0}, cpm{0};
    uint8_t rgb[3]{0, 0, 0};
    static constexpr uint32_t NONE{0};
    static constexpr uint32_t SAFETY_PAUSE{1};
    static constexpr uint32_t AMR_MODE{2};
    static constexpr uint32_t AGV_MODE{3};
    static constexpr uint32_t MISSION_PAUSE{4};
    static constexpr uint32_t PATH_BLOCKED{5};
    static constexpr uint32_t MANUAL_DRIVE{6};
    static constexpr uint32_t CHARGING{10};
    static constexpr uint32_t WAITING_FOR_JOB{11};
    static constexpr uint32_t LEFT_WINKER{12};
    static constexpr uint32_t RIGHT_WINKER{13};
    static constexpr uint32_t BOTH_WINKER{14};
    static constexpr uint32_t MOVE_ACTUATOR{15};
    static constexpr uint32_t CHARGE_LEVEL{16};
    static constexpr uint32_t SHOWTIME{10000};
    static constexpr uint32_t LOCKDOWN{10001};
    static constexpr uint32_t RGB{20000};
    static constexpr uint32_t RGB_BLINK{20001};
    static constexpr uint32_t RGB_BREATH{20002};
} __attribute__((aligned(4)));

void init();
void run(void *p1, void *p2, void *p3);
extern k_thread thread;
extern k_msgq msgq;

}

// vim: set expandtab shiftwidth=4:
```

## src/rosserial.cpp
```c
/*
 * Copyright (c) 2022, LexxPluss Inc.
 * All rights reserved.
 *
 * Redistribution and use in source and binary forms, with or without
 * modification, are permitted provided that the following conditions are met:
 *
 * 1. Redistributions of source code must retain the above copyright notice,
 *    this list of conditions and the following disclaimer.
 * 2. Redistributions in binary form must reproduce the above copyright notice,
 *    this list of conditions and the following disclaimer in the documentation
 *    and/or other materials provided with the distribution.
 *
 * THIS SOFTWARE IS PROVIDED BY THE COPYRIGHT HOLDERS AND CONTRIBUTORS "AS IS" AND
 * ANY EXPRESS OR IMPLIED WARRANTIES, INCLUDING, BUT NOT LIMITED TO, THE IMPLIED
 * WARRANTIES OF MERCHANTABILITY AND FITNESS FOR A PARTICULAR PURPOSE ARE
 * DISCLAIMED. IN NO EVENT SHALL THE COPYRIGHT OWNER OR CONTRIBUTORS BE LIABLE FOR
 * ANY DIRECT, INDIRECT, INCIDENTAL, SPECIAL, EXEMPLARY, OR CONSEQUENTIAL DAMAGES
 * (INCLUDING, BUT NOT LIMITED TO, PROCUREMENT OF SUBSTITUTE GOODS OR SERVICES;
 * LOSS OF USE, DATA, OR PROFITS; OR BUSINESS INTERRUPTION) HOWEVER CAUSED AND
 * ON ANY THEORY OF LIABILITY, WHETHER IN CONTRACT, STRICT LIABILITY, OR TORT
 * (INCLUDING NEGLIGENCE OR OTHERWISE) ARISING IN ANY WAY OUT OF THE USE OF THIS
 * SOFTWARE, EVEN IF ADVISED OF THE POSSIBILITY OF SUCH DAMAGE.
 */

#include "rosserial_hardware_zephyr.hpp"
#include "rosserial_actuator.hpp"
#include "rosserial_bmu.hpp"
#include "rosserial_board.hpp"
#include "rosserial_dfu.hpp"
#include "rosserial_imu.hpp"
#include "rosserial_interlock.hpp"
#include "rosserial_led.hpp"
#include "rosserial_pgv.hpp"
#include "rosserial_tof.hpp"
#include "rosserial_uss.hpp"
#include "rosserial.hpp"
#include "rosserial_towing_unit.hpp"

namespace lexxhard::rosserial {

class {
public:
    int init() {
        nh.getHardware()->set_baudrate(921600);
        nh.initNode(const_cast<char*>("UART_6"));
        actuator.init(nh);
        bmu.init(nh);
        board.init(nh);
        dfu.init(nh);
        imu.init(nh);
        interlock.init(nh);
        led.init(nh);
        pgv.init(nh);
        tof.init(nh);
        uss.init(nh);
        towing_unit.init(nh);
        return 0;
    }
    void run() {
        while (true) {
            nh.spinOnce();
            actuator.poll();
            bmu.poll();
            board.poll(nh);
            dfu.poll();
            imu.poll();
            interlock.poll();
            led.poll();
            pgv.poll();
            tof.poll();
            uss.poll();
            towing_unit.poll();
            k_usleep(1);
        }
    }
private:
    ros::NodeHandle nh;
    ros_actuator actuator;
    ros_bmu bmu;
    ros_board board;
    ros_dfu dfu;
    ros_imu imu;
    ros_interlock interlock;
    ros_led led;
    ros_pgv pgv;
    ros_tof tof;
    ros_uss uss;
    ros_towing_unit towing_unit;
} impl;

void init()
{
    impl.init();
}

void run(void *p1, void *p2, void *p3)
{
    impl.run();
}

k_thread thread;

}

// vim: set expandtab shiftwidth=4:
```

## src/rosserial_actuator_service.hpp
```c
/*
 * Copyright (c) 2022, LexxPluss Inc.
 * All rights reserved.
 *
 * Redistribution and use in source and binary forms, with or without
 * modification, are permitted provided that the following conditions are met:
 *
 * 1. Redistributions of source code must retain the above copyright notice,
 *    this list of conditions and the following disclaimer.
 * 2. Redistributions in binary form must reproduce the above copyright notice,
 *    this list of conditions and the following disclaimer in the documentation
 *    and/or other materials provided with the distribution.
 *
 * THIS SOFTWARE IS PROVIDED BY THE COPYRIGHT HOLDERS AND CONTRIBUTORS "AS IS" AND
 * ANY EXPRESS OR IMPLIED WARRANTIES, INCLUDING, BUT NOT LIMITED TO, THE IMPLIED
 * WARRANTIES OF MERCHANTABILITY AND FITNESS FOR A PARTICULAR PURPOSE ARE
 * DISCLAIMED. IN NO EVENT SHALL THE COPYRIGHT OWNER OR CONTRIBUTORS BE LIABLE FOR
 * ANY DIRECT, INDIRECT, INCIDENTAL, SPECIAL, EXEMPLARY, OR CONSEQUENTIAL DAMAGES
 * (INCLUDING, BUT NOT LIMITED TO, PROCUREMENT OF SUBSTITUTE GOODS OR SERVICES;
 * LOSS OF USE, DATA, OR PROFITS; OR BUSINESS INTERRUPTION) HOWEVER CAUSED AND
 * ON ANY THEORY OF LIABILITY, WHETHER IN CONTRACT, STRICT LIABILITY, OR TORT
 * (INCLUDING NEGLIGENCE OR OTHERWISE) ARISING IN ANY WAY OUT OF THE USE OF THIS
 * SOFTWARE, EVEN IF ADVISED OF THE POSSIBILITY OF SUCH DAMAGE.
 */

#pragma once

#include <zephyr.h>
#include "ros/node_handle.h"
#include "lexxauto_msgs/InitLinearActuator.h"
#include "lexxauto_msgs/LinearActuatorLocation.h"
#include "actuator_controller.hpp"

namespace lexxhard {

class ros_actuator_service {
public:
    void init(ros::NodeHandle &nh) {
        nh.advertiseService(service_location);
        nh.advertiseService(service_init);
    }
private:
    void callback_location(const lexxauto_msgs::LinearActuatorLocationRequest &req, lexxauto_msgs::LinearActuatorLocationResponse &res) {
        // ROS:[center,left,right], ROBOT:[left,center,right]
        uint8_t location[3]{
            req.location.data[1],
            req.location.data[0],
            req.location.data[2]
        };
        uint8_t power[3]{
            req.power.data[1],
            req.power.data[0],
            req.power.data[2]
        };
        uint8_t detail[3];
        res.success = actuator_controller::to_location(location, power, detail) == 0;
        res.detail.data[0] = detail[1];
        res.detail.data[1] = detail[0];
        res.detail.data[2] = detail[2];
        res.detail.data_length = sizeof detail / sizeof detail[0];
    }
    void callback_init(const lexxauto_msgs::InitLinearActuatorRequest &req, lexxauto_msgs::InitLinearActuatorResponse &res) {
        // ROS:[center,left,right], ROBOT:[left,center,right]
        int8_t const directions[3]{
            req.directions.data[1],
            req.directions.data[0],
            req.directions.data[2]
        };

        res.success = actuator_controller::init_location(directions) == 0;
    }
    ros::ServiceServer<lexxauto_msgs::LinearActuatorLocationRequest, lexxauto_msgs::LinearActuatorLocationResponse, ros_actuator_service>
        service_location{"/body_control/linear_actuator_location", &ros_actuator_service::callback_location, this};
    ros::ServiceServer<lexxauto_msgs::InitLinearActuatorRequest, lexxauto_msgs::InitLinearActuatorResponse, ros_actuator_service>
        service_init{"/body_control/init_linear_actuator", &ros_actuator_service::callback_init, this};
};

}

// vim: set expandtab shiftwidth=4:
```
